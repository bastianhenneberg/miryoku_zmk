// Copyright 2021 Manna Harbour
// https://github.com/manna-harbour/miryoku

#include "../miryoku/custom_config.h"
#include "../miryoku/mapping/42/corne.h"
#include "../miryoku/miryoku.dtsi"

// euro sign
ZMK_UNICODE_SINGLE(euro_sign, N2, N0, A, C)  // €
